## config/west.yml
```yaml
manifest:
  remotes:
    - name: zmkfirmware
      url-base: https://github.com/zmkfirmware
    - name: kumamuk-git
      url-base: https://github.com/kumamuk-git
    # 1. badjeff氏のリポジトリを追加
    - name: badjeff
      url-base: https://github.com/badjeff
  projects:
    - name: zmk
      remote: zmkfirmware
      # 2. 最新のZMKを使うために revision を main に変更
      revision: main
      import: app/west.yml
    - name: zmk-pmw3610-driver
      # 3. 参照先を badjeff に、ブランチを zmk-0.4 に変更
      remote: badjeff
      revision: zmk-0.4
  self:
    path: config
```
